## kernel/tuning/Kconfig
```kconfig
config OPLUS_FEATURE_FRAME_BOOST
	bool "config frame boost3.0"
	default n
	depends on SCHED_WALT
	help
		track key thread information during frame drawing, opt task placement and frequency selection

config OPLUS_FRAME_RESCUE_LITE
	bool "Oplus Frame Rescue Lite state"
	depends on OPLUS_FEATURE_FRAME_BOOST
	default n
	help
		Reserve per-frame-group state for the experimental Frame Rescue Lite
		deadline path on Oplus FrameBoost 3.0 devices. This option does not
		change frame utilization or CPU placement until a later runtime-gated
		implementation is enabled, and remains disabled for production use
		until its lifecycle and power impact are validated.
```
